## firmware/main/Kconfig.projbuild
```kconfig
menu "Meatreader WiFi"

    config WIFI_SSID
        string "WiFi SSID"
        default ""
        help
            SSID (network name) for the development WiFi AP.
            Can be overridden at runtime via PATCH /config/staged + apply + commit.

    config WIFI_PASSWORD
        string "WiFi Password"
        default ""
        help
            WiFi password. Leave empty for open networks.

endmenu
```

## firmware/sdkconfig.defaults
```kconfig
# Meatreader ESP32 sdkconfig defaults
# Requires ESP-IDF 5.1+

# Logging
CONFIG_LOG_DEFAULT_LEVEL_INFO=y
CONFIG_LOG_MAXIMUM_LEVEL_DEBUG=y

# HTTP server
CONFIG_HTTPD_MAX_REQ_HDR_LEN=1024
CONFIG_HTTPD_MAX_URI_LEN=512
CONFIG_HTTPD_MAX_RESP_HEADERS=8
CONFIG_HTTPD_PURGE_BUF_LEN=32

# Task stacks
CONFIG_ESP_MAIN_TASK_STACK_SIZE=4096
CONFIG_FREERTOS_HZ=1000

# WiFi
CONFIG_ESP_WIFI_STATIC_RX_BUFFER_NUM=10
CONFIG_ESP_WIFI_DYNAMIC_RX_BUFFER_NUM=32

# NVS
CONFIG_NVS_ASSERT_ERROR_CHECK=y
```
